## main/Kconfig.projbuild
```kconfig
menu "Sensor Configuration"
    config GPIO_I2C_MASTER_SDA
        int "I2C Master SDA Pin"
        default 23
        help
            The GPIO pin number for I2C Master SDA. Default is 23.
    config GPIO_I2C_MASTER_SCL
        int "I2C Master SCL Pin"
        default 22
        help
            The GPIO pin number for I2C Master SCL. Default is 22.
    config GPIO_INDICATOR_LED
        int "GPIO Pin for ARGB LED"
        default 8
        help
            The GPIO pin number for inbuilt ARGB LED/indicator LED.
endmenu

menu "E-Paper Display Configuration"
    config EPD_UPDATE_INTERVAL
        int "E-Paper Update Interval (seconds)"
        default 60
        help
            How often to update the e-paper display in seconds. Default is 60 seconds.

endmenu
```
